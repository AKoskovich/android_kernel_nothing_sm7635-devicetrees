/dts-v1/;
/plugin/;

#include "../qcom/volcano-qrd.dtsi"
#include "asteroids-common.dtsi"

/ {
	model = "Nothing Phone (3a)";
	qcom,msm-id = <636 0x10000>;
	qcom,board-id = <11 0>;
	qcom,oem-id = <1>;
};
